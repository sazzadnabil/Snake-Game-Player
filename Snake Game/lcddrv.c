/****************************************Copyright (c)**************************************************
**--------------File Info-------------------------------------------------------------------------------
** File name: LCMDRV.C
** Last modified Date:
** Last Version: 1.0
** Descriptions: MG12864图形液晶模块驱动程序。T6963C控制器
** Modified by:
** Modified date:
** Version:
** Descriptions:
********************************************************************************************************/
#include "config.h"
#include "lcddrv.h"
/* 定义总线起始的GPIO，即D0对应的GPIO值(P0.4) */
/* 定义显示缓冲区 */
#define  BUS_NO		4
/* 输出总线数据宏定义 */
#define	 OutData(dat)	IO0DIR = IO0DIR |(0xff<<BUS_NO); IO0CLR = 0xff<<BUS_NO; IO0SET = (dat&0xff)<<BUS_NO
#define	 InData()	IO0DIR = IO0DIR &~(0x000000ff<<BUS_NO);dat = (uint8)((IO0PIN&(0xFFFFFFFF))>>BUS_NO)
/* 定义READ控制 */
#define  LCM_RD		12
#define  LCM_UNREAD()		IO0SET = 1<<LCM_RD
#define  LCM_READ()			IO0CLR = 1<<LCM_RD
/* 定义WRITE控制 */
#define  LCM_WR	13
#define  LCM_UNWRITE()		IO0SET = 1<<LCM_WR
#define  LCM_WRITE()		IO0CLR = 1<<LCM_WR
/* 定义C/D#控制 */
#define  LCM_CD		14
#define  LCM_COM()			IO0SET = 1<<LCM_CD
#define  LCM_DATA()			IO0CLR = 1<<LCM_CD
/* 定义C/D#控制 */
#define  LCM_CE		15
#define  LCM_DISABLE()			IO0SET = 1<<LCM_CE
#define  LCM_ENABLE()			IO0CLR = 1<<LCM_CE
/* 定义LCM操作的命令字 */
// T6963C 命令定义
#define LCM_CUR_POS 0x21 // 光标位置设置
#define LCM_CGR_POS 0x22 // CGRAM 偏置地址设置
#define LCM_ADD_POS 0x24 // 地址指针位置
#define LCM_TXT_STP 0x40 // 文本区首址
#define LCM_TXT_WID 0x41 // 文本区宽度
#define LCM_GRH_STP 0x42 // 图形区首址
#define LCM_GRH_WID 0x43 // 图形区宽度
#define LCM_MOD_OR	0x80 // 显示方式逻辑或
#define LCM_MOD_XOR 0x81 // 显示方式逻辑异或
#define LCM_MOD_AND 0x82 // 显示方式逻辑与
#define LCM_MOD_TCH 0x83 // 显示方式文本特征
#define LCM_DIS_SW	0x90 // 显示开关D0=1/0:光标闪烁启用/禁用
// D1=1/0:光标显示启用/禁用
// D2=1/0:文本显示启用/禁用
// D3=1/0:图形显示启用/禁用
#define LCM_CUR_SHP 0xA0 // 光标形状选择0xA0-0xA7表示光标占的行数
#define LCM_AUT_WR 0xB0 // 自动写设置
#define LCM_AUT_RD 0xB1 // 自动读设置
#define LCM_AUT_OVR 0xB2 // 自动读/写结束
#define LCM_INC_WR 0xC0 // 数据一次写地址加1
#define LCM_INC_RD 0xC1 // 数据一次读地址加1
#define LCM_DEC_WR 0xC2 // 数据一次写地址减1
#define LCM_DEC_RD 0xC3 // 数据一次读地址减1
#define LCM_NOC_WR 0xC4 // 数据一次写地址不变
#define LCM_NOC_RD 0xC5 // 数据一次读地址不变
#define LCM_SCN_RD 0xE0 // 屏读
#define LCM_SCN_CP 0xE8 // 屏拷贝
#define LCM_BIT_OP 0xF0 // 位操作
uint8 const  turnf[8] = {7,6,5,4,3,2,1,0};
uint8 const  DEC_HEX_TAB1[8] = {0x80, 0x40, 0x20, 0x10, 0x08, 0x04, 0x02, 0x01};
uint8 const  DEC_HEX_TAB[8] = {0x01, 0x02, 0x04, 0x08, 0x10, 0x20, 0x40, 0x80};

/*********************************************************************************************************/

/*********************************************************************************************************
** 函数名称: LCM_READSTATE
** 功能描述: 读取LCM内部的状态
** 输　入: 无
** 输　出: LCM内部状态值       
** 全局变量: 
** 调用模块: 
** Modified by:
** Modified date:
**------------------------------------------------------------------------------------------------------
********************************************************************************************************/
uint8 LCM_READSTATE()
{
	uint8 dat;
	IO0DIR &= ~(0x000000ff<<BUS_NO);
	LCM_UNWRITE();
	LCM_COM();
	LCM_READ();
	LCM_ENABLE();
	//DELAY5();
	//DELAY5();
	//DELAY5();
	//InData();
	dat = (uint8)((IO0PIN)>>BUS_NO);
	//LCM_UNREAD();
	//LCM_UNWRITE();
	LCM_DISABLE();
	return dat;
}
/*********************************************************************************************************
** 函数名称: LCM_STA01
** 功能描述: 状态位STA1,STA0判断读写指令和读写数据，在读写数据或者写入命令前必须保证均为1
** 输　入: 无 
** 输　出: 无       
** 全局变量: 无
** 调用模块: LCM_READSTATE
** Modified by:
** Modified date:
**------------------------------------------------------------------------------------------------------
********************************************************************************************************/
uint8 LCM_STA01(void)
{
    uint8 i;
    for(i=10;i>0;i--)
    {
        if(( LCM_READSTATE() & 0x03) == 0x03) // 读取状态
        {
            break;
        }
    }
    return(i); // 若返回零说明错误
}
/*********************************************************************************************************
** 函数名称: LCM_STA3
** 功能描述: 状态位STA3
** 输　入: 无 
** 输　出: 无       
** 全局变量: 无
** 调用模块: LCM_READSTATE
** Modified by:
** Modified date:
**------------------------------------------------------------------------------------------------------
********************************************************************************************************/
uint8 LCM_STA3(void)
{
    uint8 i;
    for(i=10;i>0;i--)
    {
        if(( LCM_READSTATE() & 0x08) == 0x08) // 读取状态
        {
            break;
        }
    }
    return(i); // 若返回零说明错误
}
/*********************************************************************************************************
** 函数名称: LCM_WrCommand
** 功能描述: 写命令子程序
** 输　入: command  	要写入LCM的命令字
** 输　出: 无       
** 全局变量: 无
** 调用模块: 无
** Modified by:
** Modified date:
**------------------------------------------------------------------------------------------------------
********************************************************************************************************/
void LCM_WrCommand(uint8 command) 
{
	LCM_UNREAD();
	LCM_COM();
	LCM_WRITE();
	LCM_ENABLE();
	OutData(command);
	//LCM_UNWRITE();
	//LCM_READ();
	LCM_DISABLE();
}
/*********************************************************************************************************
** 函数名称: LCM_WrData
** 功能描述: 写数据子程序
** 输　入: wrdata  	要写入LCM的数据
** 输　出: 无       
** 全局变量: 无
** 调用模块: 无
** Modified by:
** Modified date:
**------------------------------------------------------------------------------------------------------
********************************************************************************************************/
void LCM_WrData(uint8 wrdata) 
{  
	LCM_UNREAD();
	LCM_DATA();
	LCM_WRITE();
	LCM_ENABLE();
	OutData(wrdata);
	//LCM_UNWRITE();
	//LCM_READ();
	LCM_DISABLE();	 
}
/*********************************************************************************************************
** 函数名称: LCM_WrParameter
** 功能描述: 向LCM写入参数，带双参数，一个参数，或者不带参数
** 输　入: cmd参数；para1参数1；para2参数2；num参数个数 
** 输　出: 返回操作结果       
** 全局变量: 无
** 调用模块: 无
** Modified by:
** Modified date:
**------------------------------------------------------------------------------------------------------
********************************************************************************************************/
uint8 LCM_WrParameter(uint8 cmd,uint8 para1,uint8 para2,uint8 num)
{
	switch (num)
	{
		case 0x00:
		/*
			if(LCM_STA01() == 0)
    		{
        		return 1;
    		}
    	*/	
   			LCM_WrCommand(cmd);
			break;
		case 0x01:
			/*
			if(LCM_STA01() == 0)
    		{
        		return 1;
    		}
    		LCM_WrData(para1);
    		if(LCM_STA01() == 0)
    		{
       		return 2;
    		}
    		LCM_WrCommand(cmd);
    		*/
    		LCM_WrData(para1);
    		LCM_WrCommand(cmd);
			break;
		case 0x02:
		/*
			if(LCM_STA01() == 0)
    		{
        		return 1;
    		}
    		LCM_WrData(para1);
   			if(LCM_STA01() == 0)
    		{
        		return 2;
    		}
   			 LCM_WrData(para2);
    		if(LCM_STA01() == 0)
    		{
        		return 3;
    		}
    		LCM_WrCommand(cmd);
    	*/	
    	LCM_WrData(para1);
    	LCM_WrData(para2);
    	LCM_WrCommand(cmd);
			break;		
	}
	return 0;
}
/*********************************************************************************************************
** 函数名称: LCM_ReadByte
** 功能描述: 读取指定点上的字节数据
** 输　入: x,y坐标值 
** 输　出: 返回该点上的字节数据       
** 全局变量: 无
** 调用模块: 无
** Modified by:
** Modified date:
**------------------------------------------------------------------------------------------------------
********************************************************************************************************/
uint8 LCM_ReadByte(uint8 x, uint8 y) 
{
	uint8 dat=0xff;
	uint8 x1;
	uint32 iPos;
	x1 = x >> 3; // 取Y方向分页地址
	iPos = (uint32)y * 0x1e + x1;
	LCM_WrParameter(LCM_ADD_POS,iPos&0xff,iPos/256,2);
	LCM_WrParameter(LCM_NOC_RD,0,0,0);
	/*
	if(LCM_STA01() == 0)
    {
        return 1;
    }
    */
    IO0DIR = IO0DIR &~(0x000000ff<<BUS_NO);
	LCM_UNWRITE();
	LCM_DATA();
	LCM_READ();
	LCM_ENABLE();
	//InData();
	dat = (uint8)((IO0PIN)>>BUS_NO);
	LCM_DISABLE();
	return dat;

}
/*********************************************************************************************************
** 函数名称: LCM_DispIni
** 功能描述: LCM硬件初始化
** 输　入: 无 
** 输　出: 无       
** 全局变量: 无
** 调用模块: 无
** Modified by:
** Modified date:
**------------------------------------------------------------------------------------------------------
********************************************************************************************************/
void LCM_DispIni(void)
{
 uint32  i;
// 设置引脚连接模块
#if LCM_RD < 16
    PINSEL0 &= ~(3 << (2 * LCM_RD));
#else
    PINSEL1 &= ~(3 << (2 * (LCM_RD - 16)));
#endif

#if LCM_WR < 16
    PINSEL0 &= ~(3 << (2 * LCM_WR));
#else
    PINSEL1 &= ~(3 << (2 * (LCM_WR - 16)));
#endif

#if LCM_CD < 16
    PINSEL0 &= ~(3 << (2 * LCM_CD));
#else
    PINSEL1 &= ~(3 << (2 * (LCM_CD - 16)));
#endif

#if  BUS_NO<9
    for (i = BUS_NO; i < BUS_NO+8; i++)
    {
        PINSEL0 &= ~(3 << (2 * i));
    }
#else
    for (i = BUS_NO; i < 16; i++)
    {
        PINSEL0 &= ~(3 << (2 * i));
    }
    for (; i < (BUS_NO+8); i++)
    {
        PINSEL1 &= ~(3 << (2 * (i-16)));
    }  
#endif    
  // 设置I/O为输出方式
  IO0DIR = IO0DIR|(1<<LCM_RD)|(1<<LCM_WR)|(1<<LCM_CD)|(1<<LCM_CE);
  IO0DIR = IO0DIR|(0xFF<<BUS_NO);
  
  LCM_WrParameter(LCM_TXT_STP,0x00,0x00,2);
  LCM_WrParameter(LCM_TXT_WID,0x1E,0x00,2);
  LCM_WrParameter(LCM_GRH_STP,0x00,0x00,2);
  LCM_WrParameter(LCM_GRH_WID,0x1E,0x00,2);
  LCM_WrParameter(LCM_CUR_SHP|0x01,0,0,0);
  LCM_WrParameter(LCM_MOD_OR,0,0,0);
  LCM_WrParameter(LCM_DIS_SW|0x08,0,0,0);  
}
/*********************************************************************************************************
** 函数名称: GUI_FillSCR()
** 功能描述: 全屏填充。直接使用数据填充显示缓冲区。根据LCM的实际情况编写此函数
** 输　入: dat		填充的数据
** 输　出: 无       
** 全局变量: 无
** 调用模块: 无
** Modified by:
** Modified date:
**------------------------------------------------------------------------------------------------------
********************************************************************************************************/
void  GUI_FillSCR(TCOLOR dat)
{
	uint32	i;
	LCM_WrParameter(LCM_ADD_POS,0x00,0x00,2);
	LCM_WrParameter(LCM_AUT_WR,0x00,0x00,0);
	for(i=0;i<240*128/8;i++)
	{
		//LCM_STA3();
		LCM_WrData(dat);	
	}
	LCM_WrParameter(LCM_AUT_OVR,0x00,0x00,0);
	LCM_WrParameter(LCM_ADD_POS,0x00,0x00,2);
}
/*********************************************************************************************************
** 函数名称: GUI_Initialize
** 功能描述: 初始化GUI，包括初始化显示缓冲区，初始化LCM并清屏
** 输　入: 无 
** 输　出: 无       
** 全局变量: 无
** 调用模块: 无
** Modified by:
** Modified date:
**------------------------------------------------------------------------------------------------------
********************************************************************************************************/
void  GUI_Initialize(void)
{  
	LCM_DispIni();					// 初始化LCM模块工作模式，纯图形模式
	GUI_FillSCR(0x00);				// 初始化缓冲区为0x00，并输出屏幕(清屏)
}
/*********************************************************************************************************
** 函数名称: GUI_Point
** 功能描述: 在指定位置上画点
** 输　入: x指定点所在列的位置；y指定点所在行的位置；color显示颜色(对于黑白色LCM，为0时灭，为1时显示)
** 输　出: 返回值为1时表示操作成功，为0时表示操作失败       
** 全局变量: 无
** 调用模块: 无
** Modified by:
** Modified date:
**------------------------------------------------------------------------------------------------------
********************************************************************************************************/


uint8  GUI_Point(uint8 x, uint8 y, TCOLOR color)
{
	uint8 x1;
	uint32 iPos;
	x1 = x >> 3; // 取Y方向分页地址,因为最小存储单元为8*8,按8行一个单元访问
	iPos = (uint32)y * 0x1e + x1;//计算地址:0xle是文本的宽度,高度
	LCM_WrParameter(LCM_ADD_POS,iPos&0xff,iPos/256,2);//分别取出低地址，高地址;写入LCD 
	x1 = turnf[ x & 0x07 ];//计算具体的行
	//uint8 const  turnf[8] = {7,6,5,4,3,2,1,0}; 
	color = color <<3;
	x1 = LCM_BIT_OP|x1|color; // 字节内位置计算,LCM_BIT_OP为位操作指令
	/*位操作： 
	1 1 1 1 N3 N2 N2 N0 
	无参数 
	该指令可将显示缓冲区某单元的某一位清零或置1，该单元地址由当前地址指针提供。
	N3＝1置1，N3＝0  清零。N2－N0：操作位对应单元的D0－D7位。*/
	LCM_WrParameter(x1,0,0,0);;
	return	1;	
}


/*********************************************************************************************************
** 函数名称: GUI_ReadPoint
** 功能描述: 读取指定点的颜色。对于单色，设置ret的d0位为1或0，4级灰度则为d0、d1有效，8位RGB则d0--d7有效，RGB结构则R、G、B变量有效
** 输　入: x指定点所在列的位置； y指定点所在行的位置；ret保存颜色值的指针
** 输　出: 返回0表示指定地址超出缓冲区范围       
** 全局变量: 无
** 调用模块: 无
** Modified by:
** Modified date:
**------------------------------------------------------------------------------------------------------
********************************************************************************************************/
uint8  GUI_ReadPoint(uint8 x, uint8 y, TCOLOR *ret)
{
	TCOLOR	bak;
	uint8	x1;
	bak = LCM_ReadByte(x,y);
	x1 = turnf[ x & 0x07 ];
	if( (bak & (DEC_HEX_TAB[x1&0x07]) ) ==0)
		*ret = 0x00;
	else
		*ret = 0x01;
	return	1;
}
/*********************************************************************************************************
** 函数名称: GUI_HLine
** 功能描述: 画水平线，操作失败原因是指定地址超出缓冲区范围
** 输　入:  x0    水平线起点所在列的位置
*           y0    水平线起点所在行的位置
*           x1    水平线终点所在列的位置
*           color 显示颜色(对于黑白色LCM，为0时灭，为1时显示)
** 输　出: 无       
** 全局变量: 无
** 调用模块: 无
** Modified by:
** Modified date:
**------------------------------------------------------------------------------------------------------
********************************************************************************************************/
void  GUI_HLine(uint8 x0, uint8 y0, uint8 x1, TCOLOR color) 
{  uint8  bak;
   if(x0>x1) 						// 对x0、x1大小进行排列，以便画图
   {  bak = x1;
      x1 = x0;
      x0 = bak;
   }
   do
   {  GUI_Point(x0, y0, color);		// 逐点显示，描出垂直线
      x0++;
   }while(x1>=x0);
}

/*********************************************************************************************************
** 函数名称: GUI_RLine
** 功能描述: 画竖直线。
** 输　入:  x0    水平线起点所在列的位置
*           y0    水平线起点所在行的位置
*           x1    水平线终点所在列的位置
*           color 显示颜色(对于黑白色LCM，为0时灭，为1时显示)
** 输　出: 无       
** 全局变量: 无
** 调用模块: 无
** Modified by:
** Modified date:
**------------------------------------------------------------------------------------------------------
********************************************************************************************************/
void  GUI_RLine(uint8 x0, uint8 y0, uint8 y1, TCOLOR color) 
{  uint8  bak;
   if(y0>y1) 						// 对x0、x1大小进行排列，以便画图
   {  bak = y1;
      y1 = y0;
      y0 = bak;
   }
   do
   {  GUI_Point(x0, y0, color);		// 逐点显示，描出垂直线
      y0++;
   }while(y1>=y0);
}


/*********************************************************************************************************
**                            End Of File
********************************************************************************************************/
